/*
 * RAM disk for MOFS VFS host.
 * Size: 4096 * 256 = 1 MiB. Sector size matches MOFS default block size.
 */
/ {
	ramdisk0: ramdisk0 {
		compatible = "zephyr,ram-disk";
		disk-name = "RAM";
		sector-size = <4096>;
		sector-count = <256>;
	};
};
